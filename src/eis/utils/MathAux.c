#include "MathAux.h"
// Lookup tables (generated). Table size: 256 entries each.

const int16_t sin_table_q15[256] PROGMEM = {
  0,804,1608,2410,3212,4011,4808,5602,
  6393,7179,7962,8739,9512,10278,11039,11793,
  12539,13279,14010,14732,15446,16151,16846,17530,
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  -6393,-5602,-4808,-4011,-3212,-2410,-1608,-804
};

const int16_t cos_table_q15[256] PROGMEM = {
  32767,32757,32728,32678,32609,32521,32412,32285,
  32137,31971,31785,31580,31356,31113,30852,30571,
  30273,29956,29621,29268,28898,28510,28105,27683,
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  32137,32285,32412,32521,32609,32678,32728,32757
};

const int16_t atan_table_q15[256] PROGMEM = {
  0,128,257,385,514,642,771,899,
  1028,1156,1284,1413,1541,1669,1797,1925,
  2053,2181,2309,2437,2565,2692,2820,2947,
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  25279,25345,25411,25476,25541,25606,25671,25735
};

const float log10_table[256] PROGMEM = {
  -3.00000000e+00f, -2.96470588e+00f, -2.92941176e+00f, -2.89411765e+00f,
  -2.85882353e+00f, -2.82352941e+00f, -2.78823529e+00f, -2.75294118e+00f,
  -2.71764706e+00f, -2.68235294e+00f, -2.64705882e+00f, -2.61176471e+00f,
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  5.89411765e+00f, 5.92941176e+00f, 5.96470588e+00f, 6.00000000e+00f
};

const float exp_table[256] PROGMEM = {
  2.06115362e-09f, 2.41120972e-09f, 2.82071762e-09f, 3.29977430e-09f,
  3.86019159e-09f, 4.51578737e-09f, 5.28272629e-09f, 6.17991831e-09f,
  7.22948496e-09f, 8.45730481e-09f, 9.89365149e-09f, 1.15739402e-08f,
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  3.03051030e+08f, 3.54519713e+08f, 4.14729581e+08f, 4.85165195e+08f
};

// Access helpers
static inline int16_t sin_q15_from_idx(uint16_t idx) {
  idx %= (uint16_t)(256);
  return (int16_t)pgm_read_word(&sin_table_q15[idx]);
}
static inline int16_t cos_q15_from_idx(uint16_t idx) {
  idx %= (uint16_t)(256);
  return (int16_t)pgm_read_word(&cos_table_q15[idx]);
}
static inline int16_t atan_q15_from_idx(uint16_t idx) {
  if (idx >= (uint16_t)(256)) idx = 256-1;
  return (int16_t)pgm_read_word(&atan_table_q15[idx]);
}
// Read float from PROGMEM
static inline float read_log10_table(uint16_t idx) {
  if (idx >= (uint16_t)(256)) idx = 256-1;
  float v;
  memcpy_P(&v, &log10_table[idx], sizeof(float));
  return v;
}
static inline float read_exp_table(uint16_t idx) {
  if (idx >= (uint16_t)(256)) idx = 256-1;
  float v;
  memcpy_P(&v, &exp_table[idx], sizeof(float));
  return v;
}

float sin_approx(float ang) {
  // ang em radianos, retorna [-1..1]
  float frac = ang / TWO_PI;
  // frac = frac - floor(frac) but avoid math.h floor: use truncation + adjust
  int32_t ip = (int32_t)frac;          // trunc toward zero
  frac = frac - (float)ip;
  if (frac < 0.0f) frac += 1.0f;

  float xf = frac * (float)TABLE_SIZE;
  uint16_t idx = (uint16_t)xf;
  if (idx >= TABLE_SIZE) idx = 0;
  uint16_t idx2 = (idx + 1) & (TABLE_SIZE - 1); // TABLE_SIZE must be power of two for this mask trick; else use modulo
  float t = xf - (float)idx;

  int16_t v1 = (int16_t)pgm_read_word(&sin_table_q15[idx]);
  int16_t v2 = (int16_t)pgm_read_word(&sin_table_q15[idx2]);

  float s1 = (float)v1 / 32767.0f;
  float s2 = (float)v2 / 32767.0f;
  return s1 + (s2 - s1) * t;
}

float cos_approx(float ang) {
  // cos(x) = sin(x + pi/2)
  return sin_approx(ang + (PI / 2.0f));
}


float atan_ratio_lookup(float ratio) {
  if (ratio <= 0.0f) return 0.0f;
  if (ratio >= 1.0f) ratio = 1.0f;
  float xf = ratio * (float)(TABLE_SIZE - 1);
  uint16_t idx = (uint16_t)xf;
  if (idx >= (TABLE_SIZE - 1)) {
      int16_t v = (int16_t)pgm_read_word(&atan_table_q15[TABLE_SIZE - 1]);
      return (float)v / 32767.0f;
  }
  uint16_t idx2 = idx + 1;
  float t = xf - (float)idx;
  int16_t a1 = (int16_t)pgm_read_word(&atan_table_q15[idx]);
  int16_t a2 = (int16_t)pgm_read_word(&atan_table_q15[idx2]);
  float f1 = (float)a1 / 32767.0f;
  float f2 = (float)a2 / 32767.0f;
  return f1 + (f2 - f1) * t;
}

float atan2_approx(float y, float x) {
  if (x == 0.0f) {
    if (y > 0.0f) return PI / 2.0f;
    if (y < 0.0f) return -PI / 2.0f;
    return 0.0f;
  }

  float ay = (y < 0.0f) ? -y : y;
  float ax = (x < 0.0f) ? -x : x;
  float theta;

  if (ay <= ax) {
    float ratio = (ax == 0.0f) ? 0.0f : (ay / ax);
    theta = atan_ratio_lookup(ratio);
  } else {
    float ratio = (ay == 0.0f) ? 0.0f : (ax / ay);
    theta = (PI / 2.0f) - atan_ratio_lookup(ratio);
  }

  if (x < 0.0f) {
    if (y >= 0.0f) theta = PI - theta;
    else theta = -PI + theta;
  } else {
    if (y < 0.0f) theta = -theta;
  }
  return theta;
}

// Simple fast round (avoid roundf from math lib)
int my_roundf(float x) {
  return (int)(x >= 0.0f ? x + 0.5f : x - 0.5f);
}

/*
Usage notes and strategies:

1) sin/cos:
  - Use the sin_table_q15 and cos_table_q15 (Q15 fixed-point).
  - Index into the table with: idx = (phase * TABLE_SIZE) >> PHASE_SCALE;
    Example: if phase is in [0..65535), idx = (phase * N) >> 16.
  - Convert Q15 to float or use fixed-point math:
      float s = sin_q15_from_idx(idx) / 32767.0f;
      or use Q15 directly with fixed-point arithmetic.

2) atan2 approximation:
  - Use atan_table_q15 for ratio in [0..1] (i.e., atan(y/x) when |y|<=|x|).
  - For general atan2(y,x):
    - handle quadrants,
    - if |y| <= |x| use atan_table[round((|y|/|x|)*(N-1))]
      else use (pi/2 - atan_table[round((|x|/|y|)*(N-1))])
  - Multiply/divide using fixed point or floats as needed.

3) pow/log10:
  - Precompute log10_table over a practical range (here 1e-3..1e6).
  - To compute pow(a,b) use: pow(a,b) = exp( b * ln(a) )
    - Read ln(a) (using log10 then ln = log10*ln(10)) or build ln table.
    - Use exp_table (which maps y to exp(y)) by scaling y to table index and interpolating.
  - Alternatively, precompute pow(a,b) for expected discrete values of a or b if ranges are small.

4) round:
  - Avoid heavy math lib round(). Use integer trick:
      int myround(float x) { return (int) (x >= 0 ? x + 0.5f : x - 0.5f); }
  - Or precompute fractional->rounded mapping for specific ranges if needed.

5) Memory optimizations:
  - Store tables as int16 (Q15) where possible (halves memory vs float).
  - Use interpolation (linear) between table entries to get higher precision with small tables.
  - Move large arrays to PROGMEM (see examples above) and read with pgm_read_word / memcpy_P.
  - If using ARM/ESP32 (flash mapped), PROGMEM is not necessary; use 'const' only.

6) Table sizes and precision:
  - N=256 is a compromise. Increase N for better accuracy.
  - Estimate memory: int16 table uses 2*N bytes; float table uses 4*N bytes.

*/
